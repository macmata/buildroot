## package/cukinia/Config.in
```kconfig
config BR2_PACKAGE_CUKINIA
	bool "cukinia"
	help
	  Cukinia is designed to help Linux-based embedded firmware
	  developers run simple validation tests on their firmware.

	  https://github.com/savoirfairelinux/cukinia

config BR2_PACKAGE_CUKINIA_BOOT
	bool "run at boot time"
	depends on BR2_PACKAGE_CUKINIA && (BR2_INIT_SYSV || BR2_INIT_BUSYBOX)
```

## package/mkpimage/Config.in.host
```kconfig
config BR2_PACKAGE_HOST_MKPIMAGE
	bool "host mkpimage"
	help
	  Generate signature for altera spl
	  Source from  https://git.pengutronix.de/cgit/barebox/tree/scripts/socfpga_mkimage.c?id=55d29525146dcd280987dfd565bfd34f08858fb3
```
